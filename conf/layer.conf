## conf/layer.conf
```bitbake
# We have a conf and classes directory, add to BBPATH
BBPATH .= ":${LAYERDIR}"

# We have recipes-* directories, add to BBFILES
BBFILES += "${LAYERDIR}/recipes-*/*/*.bb \
            ${LAYERDIR}/recipes-*/*/*.bbappend"

BBFILE_COLLECTIONS += "meta-alexa"
BBFILE_PATTERN_meta-alexa = "^${LAYERDIR}/"
BBFILE_PRIORITY_meta-alexa = "6"

LAYERDEPENDS_meta-alexa = "core"
LAYERSERIES_COMPAT_meta-alexa = "warrior"
LICENSE_FLAGS_WHITELIST="commercial"
```
